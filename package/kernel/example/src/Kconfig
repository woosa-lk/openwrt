## package/kernel/example/src/Kconfig
```kconfig
config CONFIG_EXAMPLE
	tristate "Just a example"
	help
	This is a example, for debugging kernel model.
	If unsure, say N.
```

## package/kernel/globalmem/src/Kconfig
```kconfig
config CONFIG_GLOBALMEM
	tristate "globalmem device driver"
	help
	This is a globalmem driver, for debugging kernel model.
	If unsure, say N.
```

## package/kernel/woosa-infrared/src/Kconfig
```kconfig
config CONFIG_WOOSA_INFRARED
	tristate "support infrared driver"
	help
	This is a infrared driver, for debugging kernel model.
	If unsure, say N.
```
